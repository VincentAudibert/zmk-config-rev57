## config/boards/shields/biGH/Kconfig.defconfig
```kconfig
# Copyright (c) 2020 The ZMK Contributors
# SPDX-License-Identifier: MIT

if SHIELD_BIGH

config ZMK_KEYBOARD_NAME
    default "biGH"

endif
```
